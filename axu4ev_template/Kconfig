## axu4ev_template/Kconfig
```kconfig
mainmenu "AXU4EV-F Vivado template (Vivado 2023.1)"

menu "Board and shared PS DDR4"
config BOARD_AXU4EV
	bool
	default y

config PL_RESERVED_MB
	int "PS DDR reserved for PL/DMA (MiB, multiples of 64)"
	range 0 2048
	default 1024
	help
	  The module has one 4 GiB PS DDR4 subsystem and no separate PL DDR.
	  Reserve memory from the top of the physical high DDR bank for PL AXI
	  masters. This only describes software ownership; it is not an AXI firewall.

config PL_CLOCK_MHZ
	int "PS PL0 fabric clock (MHz)"
	range 50 200
	default 100
endmenu

menu "PS peripherals (disabled means controller/pin mux disabled)"
config PS_UART0
	bool
	default y
	help
	  Fixed debug console on MIO42/43 through the carrier CP2102 USB serial port.

config PS_I2C0
	bool "I2C0 (MIO34/35): carrier 24LC04 EEPROM and LM75 sensor"
	default y

config PS_GEM3
	bool "GEM3 Ethernet (MIO64..77), RTL8211F PHY, MDIO address 1"
	default y

config PS_QSPI
	bool "QSPI flash (MIO0..6), MT25QU256ABA, single x4"
	default y

config PS_EMMC
	bool "SD0 / 8 GB eMMC (MIO13..23, 8-bit; reset MIO23 active low)"
	default y

config PS_SD
	bool "SD1 / microSD (MIO45..51, card detect MIO45)"
	default y

config PS_USB0
	bool "USB 2.0 ULPI (MIO52..63), reset MIO31"
	default y

config PS_USB3
	bool "USB 3.0 PS GTR lane 1 / Ref Clk1 26 MHz"
	depends on PS_USB0
	default y

config PS_DP
	bool "DisplayPort (AUX MIO27..30, GTR lanes 2/3, Ref Clk2 27 MHz)"
	default y

config PS_RTC
	bool "PS RTC (battery required for time retention)"
	default y
endmenu

menu "PL block design"
config PL_GPIO
	bool "AXI GPIO internal 32-bit output-to-input loopback"
	default y

config PL_BRAM
	bool "AXI BRAM / 64 KiB"
	default y

config PL_DMA
	bool "AXI DMA + AXIS FIFO loopback to shared PS DDR (40-bit addresses)"
	depends on PL_RESERVED_MB > 0
	default y

config PL_UART
	bool "AXI UARTLite to carrier CP2102 USB virtual COM port (115200 8N1)"
	default y
	help
	  UART RX/TX use the carrier level translator. The PL-side signals are 1.8 V.
endmenu
```

## axu4ev_template/configs/axu4ev_defconfig
```kconfig
CONFIG_BOARD_AXU4EV=y
CONFIG_PL_RESERVED_MB=1024
CONFIG_PL_CLOCK_MHZ=100
CONFIG_PS_I2C0=y
CONFIG_PS_GEM3=y
CONFIG_PS_QSPI=y
CONFIG_PS_EMMC=y
CONFIG_PS_SD=y
CONFIG_PS_USB0=y
CONFIG_PS_USB3=y
CONFIG_PS_DP=y
CONFIG_PS_RTC=y
CONFIG_PL_GPIO=y
CONFIG_PL_BRAM=y
CONFIG_PL_DMA=y
CONFIG_PL_UART=y
```

## axu4ev_template/configs/minimal_defconfig
```kconfig
CONFIG_BOARD_AXU4EV=y
CONFIG_PL_RESERVED_MB=0
CONFIG_PL_CLOCK_MHZ=100
CONFIG_PS_UART0=y
# CONFIG_PS_I2C0 is not set
# CONFIG_PS_GEM3 is not set
# CONFIG_PS_QSPI is not set
# CONFIG_PS_EMMC is not set
# CONFIG_PS_SD is not set
# CONFIG_PS_USB0 is not set
# CONFIG_PS_USB3 is not set
# CONFIG_PS_DP is not set
# CONFIG_PS_RTC is not set
# CONFIG_PL_GPIO is not set
# CONFIG_PL_BRAM is not set
# CONFIG_PL_DMA is not set
# CONFIG_PL_UART is not set
```

## fz5_template/Kconfig
```kconfig
mainmenu "EdgeBoard FZ5 Vivado template (2023.1)"

menu "Board and shared DDR4"
choice BOARD
	prompt "Physical board DDR population"
	default BOARD_FZ5D
config BOARD_FZ5D
	bool "FZ5D: 8 GiB PS DDR4"
config BOARD_FZ5C
	bool "FZ5C: 4 GiB PS DDR4"
endchoice

choice SPEED_GRADE
	prompt "Device speed grade (check chip marking)"
	default SPEED_1
config SPEED_1
	bool "xczu5ev-sfvc784-1-i (reference XSA / V13 schematic)"
config SPEED_2
	bool "xczu5ev-sfvc784-2-i (hardware manual alternative)"
endchoice

config PL_RESERVED_MB
	int "DDR reserved for PL/DMA (MiB, multiples of 64)"
	range 0 6144 if BOARD_FZ5D
	range 0 2048 if BOARD_FZ5C
	default 1024
	help
	  There is no separate PL DDR on this board. Reserve the top of the
	  high PS DDR bank for PL AXI masters. The low 2 GiB stays with PS.
	  Generates a Linux reserved-memory fragment and a Vitis memory contract.
	  This reservation is a software ownership rule, not an AXI firewall.

config PL_CLOCK_MHZ
	int "PS-to-PL clock (PL0, MHz)"
	range 50 200
	default 100
	help
	  The PS derives pl_clk0 from the board's 33.333 MHz PS reference using
	  a PLL and clock dividers. Vivado connects pl_clk0 to the template's
	  AXI logic. This setting is the target output frequency of PL0.
endmenu

menu "PS peripherals (disabled means controller/pin mux disabled)"
config PS_UART0
	bool
	default y
	help
	  J13 debug console, MIO26/27, 115200 8N1. Required by diagnostics.
comment "UART0/J13 console and GPIO board controls are always enabled"
config PS_UART1
	bool "UART1 / RS485 J11 (MIO8/9, direction MIO11)"
	default y
config PS_I2C1
	bool "I2C1 (MIO24/25): EEPROM 0x51, clock 0x76, PMIC 0x5e"
	default y
config PS_CAN1
	bool "CAN1 / J14 (MIO28/29)"
	default y
config PS_GEM3
	bool "GEM3 Ethernet / J17 (MIO64..77), PHY MDIO address 4"
	default y
config PS_QSPI
	bool "QSPI flash (MIO0..5), single x4"
	default y
config PS_EMMC
	bool "SD0 / 32GB eMMC (MIO13..23), 8-bit"
	default y
config PS_SD
	bool "SD1 / TF card J4 (MIO46..51, card detect MIO45)"
	default y
config PS_USB0
	bool "USB0 ULPI (MIO52..63) and host hub"
	default n
config PS_USB3
	bool "USB3 on PS GTR lane1 / 26MHz Ref Clk1"
	depends on PS_USB0
	default y
config PS_DP
	bool "DisplayPort J6 / GTR lanes2,3 / 27MHz Ref Clk2"
	default n
config PS_RTC
	bool "PS RTC (battery required for time retention)"
	default y
endmenu

menu "PL block design"
config PL_GPIO
	bool "AXI GPIO internal 32-bit output-to-input loopback"
	default y
config PL_BRAM
	bool "AXI BRAM / 64 KiB"
	default y
config PL_DMA
	bool "AXI DMA + AXIS FIFO loopback into shared DDR (40-bit addresses)"
	depends on PL_RESERVED_MB > 0
	default y
config PL_RS232
	bool "AXI UARTLite / RS232 J12 (AE15 RX, AB14 TX)"
	default n
comment "HDMI/MIPI/VCU are extension points; this template adds no video IP"
endmenu
```

## fz5_template/configs/full_defconfig
```kconfig
CONFIG_BOARD_FZ5D=y
CONFIG_PL_RESERVED_MB=1024
CONFIG_PS_USB0=y
CONFIG_PS_USB3=y
CONFIG_PS_DP=y
CONFIG_PL_RS232=y
```

## fz5_template/configs/fz5c_defconfig
```kconfig
CONFIG_BOARD_FZ5C=y
CONFIG_SPEED_1=y
CONFIG_PL_RESERVED_MB=1024
CONFIG_PL_CLOCK_MHZ=100
```

## fz5_template/configs/fz5d_defconfig
```kconfig
CONFIG_BOARD_FZ5D=y
CONFIG_SPEED_1=y
CONFIG_PL_RESERVED_MB=1024
CONFIG_PL_CLOCK_MHZ=100
```

## fz5_template/configs/minimal_defconfig
```kconfig
CONFIG_BOARD_FZ5D=y
CONFIG_PL_RESERVED_MB=0
# CONFIG_PS_UART1 is not set
# CONFIG_PS_I2C1 is not set
# CONFIG_PS_CAN1 is not set
# CONFIG_PS_GEM3 is not set
# CONFIG_PS_QSPI is not set
# CONFIG_PS_EMMC is not set
# CONFIG_PS_SD is not set
# CONFIG_PS_RTC is not set
# CONFIG_PL_GPIO is not set
# CONFIG_PL_BRAM is not set
# CONFIG_PL_DMA is not set
```
